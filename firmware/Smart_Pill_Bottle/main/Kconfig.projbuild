## firmware/Smart_Pill_Bottle/main/Kconfig.projbuild
```kconfig
menu "Smart Pill Bottle (Farda)"

    config SPB_DEBUG_BUILD
        bool "Build with debug command surface (READ_LOG_FILE, GATTS DB dump)"
        default y
        help
            B5 build hygiene gate. When enabled, the firmware compiles in the
            debug-only BLE commands (READ_LOG_FILE 0x33, DELETE_LOG_FILE 0x34)
            and the GATTS database dump routine. Production / release images
            MUST set this to n (see sdkconfig.defaults.prod) so the debug
            surface is stripped from the binary entirely.

    config SPB_REQUIRE_TLS
        bool "Reject plaintext API targets (require https/mqtts)"
        default y
        help
            B3 transport hardening. When enabled, SET_API_TARGET rejects any
            target whose scheme is not https:// or mqtts://, and the telemetry
            client fails closed if server certificate verification cannot be
            performed. Disable ONLY for isolated bench testing.

    config SPB_RESTRICT_API_DOMAIN
        bool "Restrict SET_API_TARGET to allowed backend domain(s)"
        default y
        help
            B3. When enabled, SET_API_TARGET only accepts hosts that match the
            allow-list compiled into board_config.h (the Farda backend
            domain). Prevents redirecting telemetry to an attacker host.

endmenu
```

## firmware/Smart_Pill_Bottle/sdkconfig.defaults
```kconfig
# sdkconfig.defaults - Farda Smart Pill Bottle (REFERENCE, DEV defaults)
#
# Baseline development configuration for ESP-IDF v5.4.1, ESP32-WROOM-32D.
# Production hardening (Secure Boot v2, flash encryption, release stripping)
# lives in sdkconfig.defaults.prod and is gated behind explicit maintainer
# sign-off (see docs/PROVISIONING.md) because those settings BURN one-way
# eFuses. DO NOT enable them automatically.

# --- Target / chip ---
CONFIG_IDF_TARGET="esp32"
CONFIG_ESPTOOLPY_FLASHSIZE_4MB=y
CONFIG_ESPTOOLPY_FLASHMODE_DIO=y
CONFIG_ESPTOOLPY_FLASHFREQ_40M=y

# --- Partition table ---
CONFIG_PARTITION_TABLE_CUSTOM=y
CONFIG_PARTITION_TABLE_CUSTOM_FILENAME="partitions.csv"

# --- Bluetooth: Bluedroid BLE only ---
CONFIG_BT_ENABLED=y
CONFIG_BT_BLUEDROID_ENABLED=y
CONFIG_BT_BLE_ENABLED=y
CONFIG_BT_GATTS_ENABLE=y
CONFIG_BT_CONTROLLER_ONLY=n
# B2: require LE Secure Connections + bonding + MITM protection. Privileged
# characteristics demand an encrypted, authenticated link.
CONFIG_BT_BLE_SMP_ENABLE=y
CONFIG_BT_SMP_ENABLE=y
CONFIG_BT_BLE_42_FEATURES_SUPPORTED=y
# Classic BT off (BLE-only device).
CONFIG_BT_CLASSIC_ENABLED=n

# --- FreeRTOS / watchdog (5-second TWDT per feature doc) ---
CONFIG_ESP_TASK_WDT_EN=y
CONFIG_ESP_TASK_WDT_TIMEOUT_S=5
CONFIG_ESP_TASK_WDT_INIT=y

# --- Filesystem: SPIFFS for cached log ---
CONFIG_SPIFFS_PAGE_SIZE=256

# --- TLS / crypto (B1, B3): mbedTLS, server cert verification on ---
CONFIG_ESP_TLS_USING_MBEDTLS=y
CONFIG_MBEDTLS_HARDWARE_AES=y
CONFIG_MBEDTLS_HARDWARE_SHA=y
# B1: HMAC-SHA256 / SHA-256 only. SHA-1 left available ONLY because the X.509
# / TLS chain may still need it for legacy CA parsing; it is NOT used for our
# own auth path. See device_identity (HMAC-SHA256).
CONFIG_MBEDTLS_SHA256_C=y
CONFIG_MBEDTLS_SHA512_C=y

# --- MQTT (mqtts) ---
CONFIG_MQTT_PROTOCOL_5=y

# --- HTTP(S) client / OTA ---
CONFIG_ESP_HTTPS_OTA_ALLOW_HTTP=n

# --- Logging (dev build keeps INFO; release lowers this, see prod) ---
CONFIG_LOG_DEFAULT_LEVEL_INFO=y

# --- App descriptor: embed project version from git (B5) ---
CONFIG_APP_PROJECT_VER_FROM_CONFIG=n

# --- SPB debug build flag (B5). DEV default = ON, so READ_LOG_FILE /
# DELETE_LOG_FILE / GATTS DB dump are available on the bench. Release build
# (sdkconfig.defaults.prod) sets this OFF and strips those commands. ---
CONFIG_SPB_DEBUG_BUILD=y
```

## firmware/Smart_Pill_Bottle/sdkconfig.defaults.prod
```kconfig
# sdkconfig.defaults.prod - Farda Smart Pill Bottle PRODUCTION overlay
#
# Apply ON TOP of sdkconfig.defaults for hardened production images:
#   idf.py -D SDKCONFIG_DEFAULTS="sdkconfig.defaults;sdkconfig.defaults.prod" build
#
# !!!  DANGER  !!!
# The Secure Boot v2 and Flash Encryption options below BURN ONE-WAY eFUSES on
# first boot and CANNOT be undone. They are listed here for completeness and
# reproducibility ONLY. Do NOT enable them on a device without the explicit
# maintainer sign-off and procedure in docs/PROVISIONING.md. This file should
# be applied in manufacturing only, deliberately.

# --- B5: release stripping ---
# Disable the debug/log-dump command surface (READ_LOG_FILE 0x33,
# DELETE_LOG_FILE 0x34, GATTS DB dump). Code behind CONFIG_SPB_DEBUG_BUILD is
# compiled out of the image entirely.
CONFIG_SPB_DEBUG_BUILD=n
CONFIG_LOG_DEFAULT_LEVEL_WARN=y
CONFIG_BOOTLOADER_LOG_LEVEL_WARN=y
CONFIG_COMPILER_OPTIMIZATION_SIZE=y

# --- B4: Secure Boot v2 (image signing) ---
# Verifies the app/bootloader signature; rejects unsigned images.
# BURNS eFUSES. Gated behind docs/PROVISIONING.md sign-off.
CONFIG_SECURE_BOOT=y
CONFIG_SECURE_BOOT_V2_ENABLED=y
CONFIG_SECURE_SIGNED_APPS_RSA_SCHEME=y
CONFIG_SECURE_BOOT_BUILD_SIGNED_BINARIES=y
# Path to the RSA-3072 signing key (kept OUT of the repo / in an HSM).
# TODO(provisioning): point at the manufacturing signing key, never commit it.
CONFIG_SECURE_BOOT_SIGNING_KEY="secure_boot_signing_key.pem"

# --- B4: Flash Encryption (release mode) ---
# Encrypts app + NVS-stored secrets at rest. BURNS eFUSES. Release mode
# disables the UART download path that could be used to read plaintext.
CONFIG_SECURE_FLASH_ENC_ENABLED=y
CONFIG_SECURE_FLASH_ENCRYPTION_MODE_RELEASE=y
CONFIG_SECURE_BOOT_INSECURE=n
CONFIG_SECURE_DISABLE_ROM_DL_MODE=y

# --- B4: signed OTA, anti-rollback / downgrade rejection ---
CONFIG_BOOTLOADER_APP_ROLLBACK_ENABLE=y
CONFIG_BOOTLOADER_APP_ANTI_ROLLBACK=y
CONFIG_APP_ANTI_ROLLBACK=y
# Secure version starts at 1; bump on each security-relevant release so the
# bootloader rejects downgrades.
CONFIG_BOOTLOADER_APP_SECURE_VERSION=1
CONFIG_ESP_HTTPS_OTA_ALLOW_HTTP=n

# --- B3: NVS encryption for stored secrets (Wi-Fi creds, device key) ---
CONFIG_NVS_ENCRYPTION=y
```
